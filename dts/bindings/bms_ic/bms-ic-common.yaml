## dts/bindings/bms_ic/bms-ic-common.yaml
```yaml
# Copyright (c) The Libre Solar Project Contributors
# SPDX-License-Identifier: Apache-2.0

description: Common properties for battery management ICs

properties:
  shunt-resistor-uohm:
    type: int
    description: |
      Shunt resistor value in micro-Ohm.

  board-max-current:
    type: int
    description: |
      Maximum current allowed by the board design in Amperes.

  io-channels:
    type: phandle-array
    required: false
    description: |
      List of extra NTCs that are connected to ADC channels of the MCU.
      Each entry is a phandle to an ADC controller plus the channel number.

  ntc-enable-gpios:
    type: phandle-array
    required: false
    description: |
      GPIO to power the NTCs.

  num-fet-ntcs:
    type: int
    default: 0
    description: |
      Number of NTCs connected to the FETs for over-temperature protection.
      The rest of the NTCs (if any) are assumed to be connected to the cells.
```

## dts/bindings/bms_ic/ti,bq769x0.yaml
```yaml
# Copyright (c) The Libre Solar Project Contributors
# SPDX-License-Identifier: Apache-2.0

description: Texas Instruments bq769x0 li-ion and li-phosphate battery monitor

compatible: "ti,bq769x0"

include: [ bms-ic-common.yaml, i2c-device.yaml ]

properties:
  alert-gpios:
    type: phandle-array
    required: true
    description: Alert interrupt of bq769x0

  used-cell-count:
    type: int
    required: true
    description: |
      Number of cell channels used by the board.

  thermistor-beta:
    type: int
    default: 3435
    description: |
      Thermistor beta value.

      Default is typical value for Semitec 103AT-5 thermistor.
```
